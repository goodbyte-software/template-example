## src/nordic/app/west.yml
```yaml
manifest:
  version: 0.13

  projects:
    - name: nrf
      revision: v3.1.0
      url: http://github.com/nrfconnect/sdk-nrf
      import:
        name-allowlist:
          - zephyr
          - cmsis
          - cmsis_6
          - hal_nordic
          - nrfxlib
        path-prefix: deps

  self:
    path: app
```
